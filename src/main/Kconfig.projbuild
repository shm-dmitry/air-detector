## src/main/Kconfig.projbuild
```kconfig
menu "Air-Detector Settings"
   menu "WIFI Configuration"
   	  config WIFI_SSID
   	  	string "Wifi AP SSID"
   	  	default ""

   	  config WIFI_PASSWORD
   	  	string "Wifi AP Password"
   	  	default ""
   	  	
   	  config WIFI_TOPIC
   	  	string "WiFi MQTT Topic to listen Change-SSID command"
   	  	default "/system/wifi/command"
   endmenu
   
   menu "MQTT Configuration"
      config MQTT_BROKER_URI
         string "Broker URL"
         default ""

      config MQTT_BROKER_USERNAME
	     string "Broker user name"
	     default ""

      config MQTT_BROKER_PASSWORD
	     string "Broker user password"
	     default ""
	     
	  config MQTT_TOPICS_PREFIX
	  	 string "Prefix for all topics"
	  	 default "/air/0"
	  	 
	  config MQTT_HEALTHCHECK_ENABLED
	     boolean "Enable MQTT healthchecks"
	     default false
	  	 
	  config MQTT_HEALTHCHECK_TOPIC
	  	 string "Topic to send/read healthcheck pings"
	  	 default "/system/healthcheck"
	  	 
	  config MQTT_OTA_ENABLED
	     boolean "Enable MQTT OTA"
	     default false
	  	 
	  config MQTT_OTA_TOPIC
	  	 string "Topic to read OTA firmware URL"
	  	 default "/system/ota"
	  	 
	  config MQTT_OTA_VERSION_TOPIC
	  	 string "Topic to read OTA firmware URL"
	  	 default "/system/ota/version"
   endmenu
   
   menu "LED"
   	  config LED_ENABLED
   	  	 boolean "Enable LED driver"
   	  	 default false

   	  config LED_GPIO
   	  	 int "LED DIN pin connected to (inverted signal)"
   	  	 default 4
  	 
  	  config LED_TOPIC_COMMANDS
  		 string "MQTT topic to listen commands"
  		 default "/led/command"
   endmenu

   menu "I2C"
   	  config I2C_ENABLED
   	  	boolean "Enable I2C bus"
   	  	default false
   
   	  config I2C_GPIO_SCL
   	  	int "I2C GPIO SCL pin"
   	  	default 22

   	  config I2C_GPIO_SDA
   	  	int "I2C GPIO SDA pin"
   	  	default 21
   endmenu
   
   menu "Sensors"
   	  menu "SGP41"
   	  	config SGP41_ENABLED
	   	  	boolean "Enable SGP41 sensor integraion"
	   	  	default false
   	  	
   	  	config SGP41_TOPIC_DATA
   	  		string "MQTT topic for sensor data"
   	  		default "/sgp41/data"
   	  endmenu

   	  menu "BME280"
   	  	config BME280_ENABLED
	   	  	boolean "Enable BME280 sensor integraion"
	   	  	default false
   	  	
   	  	config BME280_TOPIC_DATA
   	  		string "MQTT topic for sensor data"
   	  		default "/bme280/data"
   	  endmenu
   	  
   	  menu "Touchpad"
   	  	config TOUCHPAD_ENABLED
	   	  	boolean "Enable touchpad sensor integraion"
	   	  	default false
   	  	
	   	config TOUCHPAD_ID
	   	  	int "Touchpad ID"
	   	  	default 2
   	  	
   	  	config TOUCHPAD_TOPIC_DATA
   	  		string "MQTT topic for sensor data"
   	  		default "/touchpad/data"
   	  endmenu
   	  
   	  menu "External FAN"
   	  	config FAN_ENABLED
	   	  	boolean "Enable external fan integraion"
	   	  	default false
   	  	
	   	config FAN_GPIO
	   	  	int "FAN GPIO"
	   	  	default 25
   	  	
   	  	config FAN_TOPIC_DATA
   	  		string "MQTT topic for sensor data"
   	  		default "/fan/command"
   	  endmenu

   	  menu "Cooler FAN"
   	  	config FANPWM_ENABLED
	   	  	boolean "Enable fanpwm integraion"
	   	  	default false
   	  	
	   	config FANPWM_GPIO
	   	  	int "FANpwm GPIO"
	   	  	default 26
   	  	
   	  	config FANPWM_TOPIC_COMMAND
   	  		string "MQTT topic for commands to fan"
   	  		default "/fanpwm/command"
   	  endmenu
   	  
   	  menu "MQ136 (H2S)"
   	  	config MQ136_ENABLED
	   	  	boolean "Enable MQ136 integraion"
	   	  	default false
   	  	
	   	config MQ136_ADC_CHANNEL
	   	  	int "ADC channel connected to sensor"
	   	  	default 5
   	  	
   	  	config MQ136_TOPIC_DATA
   	  		string "MQTT topic for sensor data"
   	  		default "/mq136/data"
   	  	
   	  	config MQ136_TOPIC_COMMAND
   	  		string "MQTT topic for commands to sensor"
   	  		default "/mq136/command"
   	  endmenu
   	  
   	  menu "O2A2 (Oxygen)"
   	  	config O2A2_ENABLED
	   	  	boolean "Enable O2A2 integraion"
	   	  	default false
   	  	
	   	config O2A2_ADC_CHANNEL
	   	  	int "ADC channel connected to sensor"
	   	  	default 7
   	  	
   	  	config O2A2_TOPIC_DATA
   	  		string "MQTT topic for sensor data"
   	  		default "/o2a2/data"
   	  	
   	  	config O2A2_TOPIC_COMMAND
   	  		string "MQTT topic for commands to sensor"
   	  		default "/o2a2/command"
   	  endmenu
   	  
   	  menu "Light sensor"
   	  	config LIGHT_ENABLED
	   	  	boolean "Enable light integraion"
	   	  	default false
   	  	
	   	config LIGHT_ADC_CHANNEL
	   	  	int "ADC channel connected to sensor"
	   	  	default 6
   	  	
   	  	config LIGHT_TOPIC_DATA
   	  		string "MQTT topic for sensor data"
   	  		default "/light/data"
   	  endmenu
   endmenu
 endmenu
 
 
```
